#include <behaviors.dtsi>
#include <dt-bindings/zmk/keys.h>
#include <dt-bindings/zmk/mouse.h>

#include "../zmk-nodefree-config/helper.h"
#include "../zmk-nodefree-config/keypos_def/keypos_48keys.h"

#include "defines.h"
#include "key_codes.h"
#include "key_clusters.h"
#include "ortholinear_keymap.h"
#include "mouse.dtsi"
#include "custom_behaviors.dtsi"
#include "combos.dtsi"


ZMK_LAYER(gal_layer,
    GAL_TOP  
    GAL_MID  
    GAL_LOW  
    GAL_BOT
)

ZMK_LAYER(cmk_layer,     
    CMK_TOP 
    CMK_MID 
    CMK_LOW 
    CMK_BOT
)

ZMK_LAYER(gam_layer,
    GAM_TOP  
    GAM_MID  
    GAM_LOW  
    GAM_BOT  
)
ZMK_LAYER(num_layer,
    NUM_TOP  
    NUM_MID  
    NUM_LOW  
    NUM_BOT  
)

ZMK_LAYER(nav_layer,
    NAV_TOP  
    NAV_MID  
    NAV_LOW  
    NAV_BOT  
)

ZMK_LAYER(ptr_layer,
    PTR_TOP  
    PTR_MID  
    PTR_LOW  
    PTR_BOT  
)

