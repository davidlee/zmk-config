#include <behaviors.dtsi>
#include <dt-bindings/zmk/keys.h>
#include <dt-bindings/zmk/mouse.h>

#include "../zmk-nodefree-config/helper.h"

#include "preonic_keypos_def.h"
#include "defines.h"
#include "mouse.dtsi"
#include "custom_behaviors.dtsi"
#include "combos.dtsi"

#include "ortholinear_keymap.h"

ZMK_LAYER(def_layer,     
    DEF_TOP 
    DEF_TOP 
    DEF_MID 
    DEF_LOW 
    DEF_BOT
)

ZMK_LAYER(gal_layer,
    GAL_TOP  
    GAL_TOP  
    GAL_MID  
    GAL_LOW  
    DEF_BOT
)

ZMK_LAYER(num_layer,
    BLANKS
    NUM_TOP  
    NUM_MID  
    NUM_LOW  
    NUM_BOT  
)

ZMK_LAYER(nav_layer,
    BLANKS
    NAV_TOP  
    NAV_MID  
    NAV_LOW  
    NAV_BOT  
)

ZMK_LAYER(ptr_layer,
    BLANKS
    PTR_TOP  
    PTR_MID  
    PTR_LOW  
    PTR_BOT  
)
